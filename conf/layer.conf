## conf/layer.conf
```bitbake
# We have a conf and classes directory, add to BBPATH
BBPATH .= ":${LAYERDIR}"

# We have recipes-* directories, add to BBFILES
BBFILES += "${LAYERDIR}/recipes-*/*/*.bb \
            ${LAYERDIR}/recipes-*/*/*.bbappend"

BBFILE_COLLECTIONS += "meta-test-framework"
BBFILE_PATTERN_meta-test-framework = "^${LAYERDIR}/"
BBFILE_PRIORITY_meta-test-framework = "6"

LAYERDEPENDS_meta-test-framework = "core"
LAYERSERIES_COMPAT_meta-test-framework = "walnascar"
```
